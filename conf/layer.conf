## conf/layer.conf
```bitbake
# We have a conf and classes directory, add to BBPATH
BBPATH .= ":${LAYERDIR}"

# We have recipes-* directories, add to BBFILES
BBFILES += "${LAYERDIR}/recipes-*/*/*.bb \
            ${LAYERDIR}/recipes-*/*/*.bbappend"

BBFILE_COLLECTIONS += "bbone"
BBFILE_PATTERN_bbone = "^${LAYERDIR}/"
BBFILE_PRIORITY_bbone = "5"

LAYERDEPENDS_bbone = "core"
LAYERSERIES_COMPAT_bbone = "rocko sumo thud"
```

## conf/machine/bbone.conf
```bitbake
#@TYPE: Machine
#@NAME: Beaglebone machine
#@DESCRIPTION: Machine configuration for http://beagleboard.org/bone and http://beagleboard.org/black boards

PREFERRED_PROVIDER_virtual/xserver ?= "xserver-xorg"
XSERVER = " \
    xserver-xorg \
    xf86-input-libinput \
    xf86-video-modesetting \
"

MACHINE_EXTRA_RRECOMMENDS = " kernel-modules kernel-devicetree kernel-dtoverlays"

EXTRA_IMAGEDEPENDS += "u-boot-bbone"

DEFAULTTUNE ?= "cortexa8thf-neon"
include conf/machine/include/tune-cortexa8.inc

IMAGE_FSTYPES += "wic.gz"

SERIAL_CONSOLE = "115200 ttyS0"

PREFERRED_PROVIDER_virtual/kernel = "linux-bbone"
PREFERRED_PROVIDER_virtual/bootloader = "u-boot-bbone"

KERNEL_IMAGETYPE = "zImage"
KERNEL_DEVICETREE = "am335x-bone.dtb am335x-boneblack.dtb"
KERNEL_EXTRA_ARGS += "LOADADDR=${UBOOT_ENTRYPOINT}"

SPL_BINARY = "MLO"
UBOOT_SUFFIX = "img"
UBOOT_MACHINE = "am335x_boneblack_config"
UBOOT_ENTRYPOINT = "0x80008000"
UBOOT_LOADADDRESS = "0x80008000"

MACHINE_FEATURES = "usbgadget usbhost vfat ext2 keyboard serial alsa"

GUI_MACHINE_CLASS = "bigscreen"

WKS_FILE ?= "bbone.wks"
do_image_wic[depends] += "mtools-native:do_populate_sysroot dosfstools-native:do_populate_sysroot"

IMAGE_BOOT_FILES ?= "${UBOOT_BINARY} MLO zImage ${KERNEL_DEVICETREE}"

# libgles / sgx will never be solved by TI!
PREFERRED_PROVIDER_virtual/libgl = "mesa"
PREFERRED_PROVIDER_virtual/egl = "mesa"
PREFERRED_PROVIDER_virtual/libgles1 = "mesa"
PREFERRED_PROVIDER_virtual/libgles2 = "mesa"
PREFERRED_PROVIDER_virtual/mesa = "mesa"

MACHINE_EXTRA_RRECOMMENDS += "${@bb.utils.contains('BBFILE_COLLECTIONS', 'mortsgna-layer', '', 'udev-udisks-rules-bbone', d)}"
```
